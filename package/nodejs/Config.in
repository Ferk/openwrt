## package/nodejs/Config.in
```kconfig
# -*- makefile-gmake -*-
#

menu "Module Selection"
     depends on PACKAGE_nodejs

config CONFIG_BR2_PACKAGE_NODEJS_NPM
	bool "NPM for the target"
	select BR2_PACKAGE_OPENSSL
	help
	  NPM is the package manager for the Node JavaScript platform.
	  Note that enabling NPM on the target also selects OpenSSL for the
	  target.

	  http://www.npmjs.org

	  Note that NPM is always built for the buildroot host.

config NODEJS_MODULE_express
	bool "Express web application framework"
	help
	  Express is a minimal and flexible node.js web application
	  framework, providing a robust set of features for building
	  single and multi-page, and hybrid web applications.

	  http://www.expressjs.com
	  https://github.com/visionmedia/express

config NODEJS_MODULE_semaphore
	bool "Semaphores for nodejs"
	default n
	help
		"Nodejs package"

config NODEJS_MODULE_sqlite3
	bool "SQLITE3 support for nodejs"
	default n
	help
		Nodejs package

config NODEJS_MODULE_imagemagick
	bool "Imagemagick tools for nodejs"
	default n
	help
		Nodejs package

config NODEJS_MODULE_locale
	bool "localization support for nodejs"
	default n
	help
		Nodejs package

config NODEJS_MODULE_request
	bool "request/response management for nodejs"
	default n
	help
		Nodejs package

config NODEJS_MODULE_forever
	bool "Management of node processes"
	default n
	help
		Nodejs package

config NODEJS_MODULE_coffeescript
	bool "CoffeeScript"
	help
	  CoffeeScript is a little language that compiles into JavaScript.

	  http://www.coffeescript.org

config NODEJS_MODULE_ADDITIONAL
	string "Additional modules"
	help
	  List of space-separated nodejs modules to install via npm.
	  See https://npmjs.org/ to find modules and 'npm help install'
	  for available installation methods.  For repeatable builds,
	  download and save tgz files or clone git repos for the
	  components you care about.

	  Example: serialport uglify-js@1.3.4 /my/module/mymodule.tgz git://github.com/someuser/somemodule.git#v1.2

	  This would install the serialport module (at the newest version),
	  the uglify-js module at 1.3.4, a module from a filesystem path,
	  and a module from a git repository.

config NODEJS_MODULE_ADDITIONAL_DEPS
	string "Additional module dependencies"
	help
	  List of space-separated buildroot recipes which must be built before
	  your npms can be installed.  For example, if in 'Additional modules'
	  you specified 'node-curl' (see:
	  https://github.com/jiangmiao/node-curl), you could then specify
	  'libcurl' here, to ensure that buildroot builds the libcurl package,
	  and does so before building your node modules.

endmenu
```
